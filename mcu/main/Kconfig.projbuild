## mcu/main/Kconfig.projbuild
```kconfig
menu "Top-Level Chromatic Firmware Version"
config CHROMATIC_FW_VER_STR
	string "Firmware Version"
	default "0.0"
	help
		The Major.Minor pair which describes a Chromatic firmware release package.
		It shall be updated any time the Chromatic microcontroller or FPGA is revised.

config CHROMATIC_FW_ID_STR
	string "Firmware name reported to PC apps"
	default ""
	help
		The "chromatic" value printed by the fwversion console command. Empty
		means the Firmware Version above. ChroMagician only manages SD files
		on firmware whose value contains "ChroMagic" (or "CM", or has the form
		"1.0.1 (4.2)"), and accepts at most 32 characters. Set this when the
		Firmware Version shown on Status names a ChroMagic-based mod without
		saying so, for example "Magic Trick 1.0 beta (ChroMagic)".
endmenu

menu "ChroMagic experimental features"
config CHROMAGIC_WIFI_FILES
    bool "Wi-Fi Files transfer mode"
    default n
    help
        Password-protected local hotspot and SD file manager. Requires the
        larger partition layout in sdkconfig.wifi.defaults; not an app-only
        upgrade from the standard 1 MiB layout.
endmenu
```
